/*
 * Left Trackball Add-on (SCROLL mode)
 * Add "skreecustom_trackball_left" to your LEFT shield list to enable
 * 
 * This trackball acts as a scroll wheel
 */

#include <zephyr/dt-bindings/input/input-event-codes.h>

&spi1 {
    cs-gpios = <&gpio0 2 GPIO_ACTIVE_LOW>;

    trackball_central: trackball_central@0 {
        status = "okay";
        compatible = "pixart,pmw3610";
        reg = <0>;
        spi-max-frequency = <2000000>;
        irq-gpios = <&gpio0 29 (GPIO_ACTIVE_LOW | GPIO_PULL_UP)>;
        cpi = <600>;
        evt-type = <INPUT_EV_REL>;
        x-input-code = <INPUT_REL_X>;
        y-input-code = <INPUT_REL_Y>;
    };
};

&trackball_central_listener {
    status = "okay";
    device = <&trackball_central>;
};
