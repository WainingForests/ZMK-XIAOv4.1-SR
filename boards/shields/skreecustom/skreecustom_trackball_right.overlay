/*
 * Right Trackball Add-on (POINTER mode)
 * Add "skreecustom_trackball_right" to your RIGHT shield list to enable
 * 
 * This trackball acts as a mouse pointer
 * Data is transmitted to the central half via split input
 */

#include <zephyr/dt-bindings/input/input-event-codes.h>

&spi1 {
    cs-gpios = <&gpio0 2 GPIO_ACTIVE_LOW>;

    trackball_peripheral: trackball_peripheral@0 {
        status = "okay";
        compatible = "pixart,pmw3610";
        reg = <0>;
        spi-max-frequency = <2000000>;
        motion-gpios = <&gpio0 29 (GPIO_ACTIVE_LOW | GPIO_PULL_UP)>;
        zephyr,axis-x = <INPUT_REL_X>;
        zephyr,axis-y = <INPUT_REL_Y>;
    };
};

/* Enable the input-split and link trackball to it */
&trackball_peripheral_split {
    status = "okay";
    device = <&trackball_peripheral>;
};
